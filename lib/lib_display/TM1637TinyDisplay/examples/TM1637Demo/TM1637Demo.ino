//  TM1637TinyDisplay DEMO Sketch
//  This is a demo sketch for the Arduino TM1637TinyDisplay LED Display library
//
//  Author: Jason A. Cox - @jasonacox
//  Date: 2 July 2020
//

// Includes
#include <Arduino.h>
#include <TM1637TinyDisplay.h>

// Define Digital Pins
#define CLK 4
#define DIO 5

// Initialize TM1637TinyDisplay
TM1637TinyDisplay display(CLK, DIO);

// Animations created with Tool https://jasonacox.github.io/TM1637TinyDisplay/examples/7-segment-animator.html

const uint8_t ANIMATION1[40][4] PROGMEM = {
  { 0x00, 0x00, 0x00, 0x00 },  // Frame 0
  { 0x01, 0x00, 0x00, 0x00 },  // Frame 1
  { 0x40, 0x01, 0x00, 0x00 },  // Frame 2
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  { 0x3f, 0x3f, 0x3f, 0x3f }   // Frame 39
};

const uint8_t ANIMATION2[33][4] PROGMEM = {
  { 0x08, 0x00, 0x00, 0x00 },  // Frame 0
  { 0x00, 0x08, 0x00, 0x00 },  // Frame 1
  { 0x00, 0x00, 0x08, 0x00 },  // Frame 2
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  { 0x00, 0x00, 0x00, 0x00 }   // Frame 32
};

const uint8_t ANIMATION3[218][4] PROGMEM = {
  { 0x08, 0x00, 0x00, 0x00 },  // Frame 0
  { 0x40, 0x08, 0x00, 0x00 },  // Frame 1
  { 0x01, 0x40, 0x08, 0x00 },  // Frame 2
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  { 0x00, 0x00, 0x00, 0x00 }   // Frame 217
};

void setup() {
  display.setBrightness(BRIGHT_7);
  display.showNumber(1234);
  delay(1000);

}
void loop() {

  // Say Hello
  display.showString("HELLO");
  delay(500);

  // Clear Screen
  display.clear();

  // We can count!
  for (int x = -110; x <= 100; x++) {
    display.showNumber(x);
    yield(); // Keep watchdog timer happy
  }
  delay(500);

  for (int x = -100; x < 100; x = x + 1) {
    display.showNumber((float)x / 10.0);
    yield(); // Keep watchdog timer happy
  }
  delay(500);

  // Demo Brightness Levels
  char string[10];
  for (int x = 0; x < 8; x++) {
    display.setBrightness(x);
    sprintf(string, "On %d", x);
    display.showString(string);
    delay(1000);
  }

  // Demo Horizontal Level Meter
  for (int count = 0; count < 3; count++) {
    for (int x = 0; x <= 100; x = x + 10) {
      display.showLevel(x, true);
      delay(20);
    }
    for (int x = 100; x >= 0; x = x - 10) {
      display.showLevel(x, true);
      delay(20);
    }
  }
  // Demo Vertical Level Meter
  for (int count = 0; count < 3; count++) {
    for (int x = 0; x <= 100; x = x + 10) {
      display.showLevel(x, false);
      delay(20);
    }
    for (int x = 100; x >= 0; x = x - 10) {
      display.showLevel(x, false);
      delay(20);
    }
  }
  delay(1000);

  // Demo split screen for temperature
  display.showString("\xB0", 1, 3);        // Degree Mark, length=1, position=3 (right)
  for (int x = -90; x < 200; x++) {
    display.showNumber(x, false, 3, 0);    // Number, length=3, position=0 (left)
    delay(10);
  }
  delay(1000);

  // Animation sequences - All in PROGMEM flash memory
  display.clear();
  display.showString("For Fun");
  delay(1000);
  display.showAnimation_P(ANIMATION1, FRAMES(ANIMATION1), TIME_MS(50));
  display.showAnimation_P(ANIMATION2, FRAMES(ANIMATION2), TIME_MS(50));
  display.showAnimation_P(ANIMATION3, FRAMES(ANIMATION3), TIME_MS(50));

  delay(5000);

}
