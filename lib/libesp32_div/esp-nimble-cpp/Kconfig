## lib/libesp32_div/esp-nimble-cpp/Kconfig
```kconfig
menu "ESP-NimBLE-CPP configuration"

choice NIMBLE_CPP_LOG_LEVEL
    prompt "NimBLE CPP log verbosity"
    default NIMBLE_CPP_LOG_LEVEL_NONE
    help
        Select NimBLE CPP log verbosity level.

    config NIMBLE_CPP_LOG_LEVEL_NONE
        bool "No logs"
    config NIMBLE_CPP_LOG_LEVEL_ERROR
        bool "Error logs"
    config NIMBLE_CPP_LOG_LEVEL_WARNING
        bool "Warning logs"
    config NIMBLE_CPP_LOG_LEVEL_INFO
        bool "Info logs"
    config NIMBLE_CPP_LOG_LEVEL_DEBUG
        bool "Debug logs"
endchoice #NIMBLE_CPP_LOG_LEVEL

config NIMBLE_CPP_LOG_LEVEL
    int
    default 0 if NIMBLE_CPP_LOG_LEVEL_NONE
    default 1 if NIMBLE_CPP_LOG_LEVEL_ERROR
    default 2 if NIMBLE_CPP_LOG_LEVEL_WARNING
    default 3 if NIMBLE_CPP_LOG_LEVEL_INFO
    default 4 if NIMBLE_CPP_LOG_LEVEL_DEBUG

config NIMBLE_CPP_LOG_OVERRIDE_COLOR
    bool "Enable log color override."
    default "n"
    help
        Enabling this option will allow NimBLE log levels to have
        specific colors assigned.

menu "NIMBLE Log Override Colors"
    depends on NIMBLE_CPP_LOG_OVERRIDE_COLOR

    choice NIMBLE_CPP_LOG_OVERRIDE_COLOR_ERR
        prompt "NimBLE CPP log override color Error"
        default NIMBLE_CPP_LOG_OVERRIDE_COLOR_ERR_NONE
        help
            Select NimBLE CPP log override error color.

        config NIMBLE_CPP_LOG_OVERRIDE_COLOR_ERR_NONE
            bool "None"
        config NIMBLE_CPP_LOG_OVERRIDE_COLOR_ERR_BLACK
            bool "Black"
        config NIMBLE_CPP_LOG_OVERRIDE_COLOR_ERR_RED
            bool "Red"
        config NIMBLE_CPP_LOG_OVERRIDE_COLOR_ERR_GREEN
            bool "Green"
        config NIMBLE_CPP_LOG_OVERRIDE_COLOR_ERR_YELLOW
            bool "Yellow"
        config NIMBLE_CPP_LOG_OVERRIDE_COLOR_ERR_BLUE
            bool "Blue"
        config NIMBLE_CPP_LOG_OVERRIDE_COLOR_ERR_PURPLE
            bool "Purple"
        config NIMBLE_CPP_LOG_OVERRIDE_COLOR_ERR_CYAN
            bool "Cyan"
    endchoice #NIMBLE_CPP_LOG_OVERRIDE_COLOR_ERR

    choice NIMBLE_CPP_LOG_OVERRIDE_COLOR_WARN
        prompt "NimBLE CPP log override color Warning"
        default NIMBLE_CPP_LOG_OVERRIDE_COLOR_WARN_NONE
        help
            Select NimBLE CPP log override warning color.

        config NIMBLE_CPP_LOG_OVERRIDE_COLOR_WARN_NONE
            bool "None"
        config NIMBLE_CPP_LOG_OVERRIDE_COLOR_WARN_BLACK
            bool "Black"
        config NIMBLE_CPP_LOG_OVERRIDE_COLOR_WARN_RED
            bool "Red"
        config NIMBLE_CPP_LOG_OVERRIDE_COLOR_WARN_GREEN
            bool "Green"
        config NIMBLE_CPP_LOG_OVERRIDE_COLOR_WARN_YELLOW
            bool "Yellow"
        config NIMBLE_CPP_LOG_OVERRIDE_COLOR_WARN_BLUE
            bool "Blue"
        config NIMBLE_CPP_LOG_OVERRIDE_COLOR_WARN_PURPLE
            bool "Purple"
        config NIMBLE_CPP_LOG_OVERRIDE_COLOR_WARN_CYAN
            bool "Cyan"
    endchoice #NIMBLE_CPP_LOG_OVERRIDE_COLOR_WARN

    choice NIMBLE_CPP_LOG_OVERRIDE_COLOR_INFO
        prompt "NimBLE CPP log override color Info"
        default NIMBLE_CPP_LOG_OVERRIDE_COLOR_INFO_NONE
        help
            Select NimBLE CPP log override info color.

        config NIMBLE_CPP_LOG_OVERRIDE_COLOR_INFO_NONE
            bool "None"
        config NIMBLE_CPP_LOG_OVERRIDE_COLOR_INFO_BLACK
            bool "Black"
        config NIMBLE_CPP_LOG_OVERRIDE_COLOR_INFO_RED
            bool "Red"
        config NIMBLE_CPP_LOG_OVERRIDE_COLOR_INFO_GREEN
            bool "Green"
        config NIMBLE_CPP_LOG_OVERRIDE_COLOR_INFO_YELLOW
            bool "Yellow"
        config NIMBLE_CPP_LOG_OVERRIDE_COLOR_INFO_BLUE
            bool "Blue"
        config NIMBLE_CPP_LOG_OVERRIDE_COLOR_INFO_PURPLE
            bool "Purple"
        config NIMBLE_CPP_LOG_OVERRIDE_COLOR_INFO_CYAN
            bool "Cyan"
    endchoice #NIMBLE_CPP_LOG_OVERRIDE_COLOR_INFO

    choice NIMBLE_CPP_LOG_OVERRIDE_COLOR_DEBUG
        prompt "NimBLE CPP log override color Debug"
        default NIMBLE_CPP_LOG_OVERRIDE_COLOR_DEBUG_NONE
        help
            Select NimBLE CPP log override debug color.

        config NIMBLE_CPP_LOG_OVERRIDE_COLOR_DEBUG_NONE
            bool "None"
        config NIMBLE_CPP_LOG_OVERRIDE_COLOR_DEBUG_BLACK
            bool "Black"
        config NIMBLE_CPP_LOG_OVERRIDE_COLOR_DEBUG_RED
            bool "Red"
        config NIMBLE_CPP_LOG_OVERRIDE_COLOR_DEBUG_GREEN
            bool "Green"
        config NIMBLE_CPP_LOG_OVERRIDE_COLOR_DEBUG_YELLOW
            bool "Yellow"
        config NIMBLE_CPP_LOG_OVERRIDE_COLOR_DEBUG_BLUE
            bool "Blue"
        config NIMBLE_CPP_LOG_OVERRIDE_COLOR_DEBUG_PURPLE
            bool "Purple"
        config NIMBLE_CPP_LOG_OVERRIDE_COLOR_DEBUG_CYAN
            bool "Cyan"
    endchoice #NIMBLE_CPP_LOG_OVERRIDE_COLOR_DEBUG
endmenu

config NIMBLE_CPP_ENABLE_RETURN_CODE_TEXT
    bool "Show NimBLE return codes as text in debug log."
    default "n"
    help
        Enabling this option will display return code values as text
        messages in the debug log. This will use approximately 8kB
        of flash memory.

config NIMBLE_CPP_ENABLE_GAP_EVENT_CODE_TEXT
    bool "Show NimBLE gap events as text in debug log."
    default "n"
    help
        Enabling this option will display gap event codes as text
        messages in the debug log. This will use approximately 1kB
        of flash memory.

config NIMBLE_CPP_ENABLE_ADVERTISEMENT_TYPE_TEXT
    bool "Show advertisment types as text in debug log."
    default "n"
    help
        Enabling this option will display advertisment types recieved
        while scanning as text messages in the debug log.
        This will use approximately 250 bytes of flash memory.

config NIMBLE_CPP_ADDR_FMT_EXCLUDE_DELIMITER
    bool "Exclude colon characters when printing address."
    default "n"
    help
        Enabling this option will format MAC addresses without
        colon characters when printing.

config NIMBLE_CPP_ADDR_FMT_UPPERCASE
    bool "Use uppercase letters when printing address."
    default "n"
    help
        Enabling this option will format MAC addresses in
        uppercase letters when printing.

config NIMBLE_CPP_ATT_VALUE_TIMESTAMP_ENABLED
    bool "Enable timestamps to be stored with attribute values."
    default "n"
    help
        Enabling this option will store the timestamp when an attribute value is updated.
        This allows for checking the last update time using getTimeStamp()
        or getValue(time_t*). If disabled, the timestamp returned from these functions will be 0.
        Disabling timestamps will reduce the memory used for each value.

config NIMBLE_CPP_ATT_VALUE_INIT_LENGTH
    int "Initial attribute value size (bytes) for empty values."
    range 1 512
    default 20
    help
        Sets the default allocation size (bytes) for each attribute if not specified
        when the constructor is called. This is also the size used when a remote
        characteristic or descriptor is constructed before a value is read/notifed.
        Increasing this will reduce reallocations but increase memory footprint.

config NIMBLE_CPP_DEBUG_ASSERT_ENABLED
    bool "Enable debug asserts."
    default "n"
    help
        Enabling this option will add debug asserts to the NimBLE CPP library.
        This will use approximately 1kB of flash memory.

config NIMBLE_CPP_FREERTOS_TASK_BLOCK_BIT
    int "FreeRTOS task block bit."
    default 31
    help
        Configure the bit to set in the task notification value when a task is blocked waiting for an event.
        This should be set to a bit that is not used by other notifications in the system.

#
# BT config
#
config BT_ENABLED
    bool "Bluetooth"
    default "y"
    help
        Select this option to enable Bluetooth and show the submenu with Bluetooth configuration choices.


config BT_NIMBLE_ENABLED
    bool "NimBLE - BLE only"
    default "y"
    help
        This option is recommended for BLE only usecases to save on memory

if IDF_TARGET_ESP32P4

    config BT_NIMBLE_TRANSPORT_UART
        bool "Enable Uart Transport"
        default "n"

    #
    # Enable ESP Hosted BT
    # Used as VHCI transport between BT Host and Controller
    #
    config ESP_ENABLE_BT
        bool "Enable Hosted Bluetooth support"
        default "y"
        help
            Enable Bluetooth Support via Hosted

    choice ESP_WIFI_REMOTE_LIBRARY
        prompt "Choose WiFi-remote implementation"
        default ESP_WIFI_REMOTE_LIBRARY_HOSTED
        help
            Select type of WiFi Remote implementation

            ESP-HOSTED is the default and most versatile option.
            It's also possible to use EPPP, which uses PPPoS link between micros and NAPT, so it's slower
            and less universal.

        config ESP_WIFI_REMOTE_LIBRARY_HOSTED
            bool "ESP-HOSTED"
    endchoice
endif

endmenu
```

## lib/libesp32_div/esp-nimble-cpp/examples/Bluetooth_5/NimBLE_extended_client/sdkconfig.defaults
```kconfig
# Override some defaults so BT stack is enabled
# in this example

#
# BT config
#
CONFIG_BT_ENABLED=y
CONFIG_BTDM_CTRL_MODE_BLE_ONLY=y
CONFIG_BTDM_CTRL_MODE_BR_EDR_ONLY=n
CONFIG_BTDM_CTRL_MODE_BTDM=n
CONFIG_BT_BLUEDROID_ENABLED=n
CONFIG_BT_NIMBLE_ENABLED=y
CONFIG_BT_NIMBLE_EXT_ADV=y
```

## lib/libesp32_div/esp32-camera/Kconfig
```kconfig
menu "Camera configuration"

    config OV7670_SUPPORT
        bool "Support OV7670 VGA"
        default y
        help
            Enable this option if you want to use the OV7670.
            Disable this option to save memory.

    config OV7725_SUPPORT
        bool "Support OV7725 VGA"
        default y
        help
            Enable this option if you want to use the OV7725.
            Disable this option to save memory.

    config NT99141_SUPPORT
        bool "Support NT99141 HD"
        default y
        help
            Enable this option if you want to use the NT99141.
            Disable this option to save memory.

    config OV2640_SUPPORT
        bool "Support OV2640 2MP"
        default y
        help
            Enable this option if you want to use the OV2640.
            Disable this option to save memory.

    config OV3660_SUPPORT
        bool "Support OV3660 3MP"
        default y
        help
            Enable this option if you want to use the OV3360.
            Disable this option to save memory.

    config OV5640_SUPPORT
        bool "Support OV5640 5MP"
        default y
        help
            Enable this option if you want to use the OV5640.
            Disable this option to save memory.

    config GC2145_SUPPORT
        bool "Support GC2145 2MP"
        default y
        help
            Enable this option if you want to use the GC2145.
            Disable this option to save memory.

    config GC032A_SUPPORT
        bool "Support GC032A VGA"
        default y
        help
            Enable this option if you want to use the GC032A.
            Disable this option to save memory.

    config GC0308_SUPPORT
        bool "Support GC0308 VGA"
        default y
        help
            Enable this option if you want to use the GC0308.
            Disable this option to save memory.

    choice SCCB_HARDWARE_I2C_PORT
        bool "I2C peripheral to use for SCCB"
        default SCCB_HARDWARE_I2C_PORT1

        config SCCB_HARDWARE_I2C_PORT0
            bool "I2C0"
        config SCCB_HARDWARE_I2C_PORT1
            bool "I2C1"

    endchoice

    choice GC_SENSOR_WINDOW_MODE
        bool "GalaxyCore Sensor Window Mode"
        depends on (GC2145_SUPPORT || GC032A_SUPPORT || GC0308_SUPPORT)
        default GC_SENSOR_SUBSAMPLE_MODE
        help
            This option determines how to reduce the output size when the resolution you set is less than the maximum resolution.
            SUBSAMPLE_MODE has a bigger perspective and WINDOWING_MODE has a higher frame rate.

        config GC_SENSOR_WINDOWING_MODE
            bool "Windowing Mode"
        config GC_SENSOR_SUBSAMPLE_MODE
            bool "Subsample Mode"
    endchoice

    choice CAMERA_TASK_PINNED_TO_CORE
        bool "Camera task pinned to core"
        default CAMERA_CORE0
        help
            Pin the camera handle task to a certain core(0/1). It can also be done automatically choosing NO_AFFINITY.

        config CAMERA_CORE0
            bool "CORE0"
        config CAMERA_CORE1
            bool "CORE1"
        config CAMERA_NO_AFFINITY
            bool "NO_AFFINITY"

    endchoice

    config CAMERA_DMA_BUFFER_SIZE_MAX
        int "DMA buffer size"
        range 8192 32768
        default 32768
        help
            Maximum value of DMA buffer
            Larger values may fail to allocate due to insufficient contiguous memory blocks, and smaller value may cause DMA interrupt to be too frequent

endmenu
```

## lib/libesp32_div/esp32-camera/examples/sdkconfig.defaults
```kconfig
CONFIG_ESP32_DEFAULT_CPU_FREQ_240=y
CONFIG_ESP32S2_DEFAULT_CPU_FREQ_240=y
CONFIG_ESP32S3_DEFAULT_CPU_FREQ_240=y

CONFIG_ESPTOOLPY_FLASHSIZE_4MB=y
CONFIG_PARTITION_TABLE_OFFSET=0x10000

CONFIG_FREERTOS_HZ=1000
CONFIG_ESPTOOLPY_FLASHFREQ_80M=y
CONFIG_ESPTOOLPY_FLASHMODE_QIO=y

CONFIG_SPIRAM_SUPPORT=y
CONFIG_ESP32_SPIRAM_SUPPORT=y
CONFIG_ESP32S2_SPIRAM_SUPPORT=y
CONFIG_ESP32S3_SPIRAM_SUPPORT=y
CONFIG_SPIRAM_SPEED_80M=y
```

## lib/libesp32_eink/epdiy/src/epd_driver/Kconfig
```kconfig
menu "E-Paper Driver"
    choice EPD_DRIVER_DISPLAY_TYPE
        prompt "Display Type"
        default EPD_DISPLAY_TYPE_ED097OC4
        help
            This option sets the display type to drive.

        config EPD_DISPLAY_TYPE_ED097OC4
            bool "ED097OC4"

        config EPD_DISPLAY_TYPE_ED060SC4
            bool "ED060SC4"

        config EPD_DISPLAY_TYPE_ED060XC3
            bool "ED060XC3"

		config EPD_DISPLAY_TYPE_ED060SCT
            bool "ED060SCT"

        config EPD_DISPLAY_TYPE_ED097TC2
            bool "ED097TC2"

        config EPD_DISPLAY_TYPE_ED133UT2
            bool "ED133UT2"
        
        config EPD_DISPLAY_TYPE_ED047TC1
            bool "ED047TC1 (LILYGO 4.7 inch)"

        config EPD_DISPLAY_TYPE_ED097OC4_LQ
            bool "ED097OC4 Low Quality"
    endchoice


    choice EPD_DRIVER_BOARD_REVISION
        prompt "Board / Board Revision"
        default EPD_BOARD_REVISION_V2_V3
        help
            The board revision to compile for.

        config EPD_BOARD_REVISION_LILYGO_T5_47
            bool "LILYGO T5-4.7 inch e-paper"

        config EPD_BOARD_REVISION_V2_V3
            bool "epdiy v2 / v3"

        config EPD_BOARD_REVISION_V4
            bool "epdiy v4"

        config EPD_BOARD_REVISION_V5
            bool "epdiy v5"
    endchoice
endmenu
```
