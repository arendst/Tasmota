## sdkconfig.defaults
```kconfig
# CONFIG_WS2812_LED_ENABLE is not set

#
# Build type
#
CONFIG_APP_REPRODUCIBLE_BUILD=y
# end of Build type

#
# Bootloader config
#

#
# Log
#
CONFIG_BOOTLOADER_LOG_LEVEL_NONE=y
# end of Log

CONFIG_BOOTLOADER_SKIP_VALIDATE_ALWAYS=y
# end of Bootloader config

#
# Application manager
#
CONFIG_APP_EXCLUDE_PROJECT_VER_VAR=y
CONFIG_APP_EXCLUDE_PROJECT_NAME_VAR=y
# end of Application manager

#
# Boot ROM Behavior
#
CONFIG_BOOT_ROM_LOG_ALWAYS_OFF=y
# end of Boot ROM Behavior

#
# Serial flasher config
#
CONFIG_ESPTOOLPY_FLASHMODE_QIO=y
# end of Serial flasher config

#
# Arduino Configuration
#
CONFIG_AUTOSTART_ARDUINO=y

#
# Debug Log Configuration
#
CONFIG_ARDUHAL_LOG_DEFAULT_LEVEL_NONE=y
# end of Debug Log Configuration
# end of Arduino Configuration

#
# Compiler options
#
CONFIG_COMPILER_OPTIMIZATION_SIZE=y
CONFIG_COMPILER_OPTIMIZATION_ASSERTIONS_DISABLE=y
CONFIG_COMPILER_OPTIMIZATION_CHECKS_SILENT=y
CONFIG_COMPILER_SAVE_RESTORE_LIBCALLS=y
CONFIG_COMPILER_DISABLE_DEFAULT_ERRORS=y
CONFIG_COMPILER_DISABLE_GCC12_WARNINGS=y
CONFIG_COMPILER_DISABLE_GCC13_WARNINGS=y
CONFIG_COMPILER_DISABLE_GCC14_WARNINGS=y
CONFIG_COMPILER_DISABLE_GCC15_WARNINGS=y
# end of Compiler options

#
# Component config
#

#
# Bluetooth
#
CONFIG_BT_ENABLED=y
CONFIG_BT_NIMBLE_ENABLED=y

#
# NimBLE Options
#

#
# GAP
#
CONFIG_BT_NIMBLE_MAX_CONNECTIONS=2
# end of GAP

#
# BLE 5.x Features
#
CONFIG_BT_NIMBLE_50_FEATURE_SUPPORT=n
# end of BLE 5.x Features

#
# Debugging/Testing
#
CONFIG_BT_NIMBLE_LOG_LEVEL_NONE=y
# end of Debugging/Testing
# end of NimBLE Options
# end of Bluetooth

#
# ESP-TLS
#
CONFIG_ESP_TLS_CUSTOM_STACK=y
# end of ESP-TLS

#
# Common ESP-related
#
CONFIG_ESP_ERR_TO_NAME_LOOKUP=n
# end of Common ESP-related

#
# ESP-Driver:I2S Configurations
#
CONFIG_I2S_ISR_IRAM_SAFE=y
# end of ESP-Driver:I2S Configurations

#
# ESP-Driver:SPI Configurations
#
CONFIG_SPI_MASTER_ISR_IN_IRAM=n
CONFIG_SPI_SLAVE_ISR_IN_IRAM=n
# end of ESP-Driver:SPI Configurations

#
# Ethernet
#
CONFIG_ETH_TRANSMIT_MUTEX=y
# end of Ethernet

#
# Event Loop Library
#
CONFIG_ESP_EVENT_POST_FROM_IRAM_ISR=n
# end of Event Loop Library

#
# ESP HTTP client
#
CONFIG_ESP_HTTP_CLIENT_ENABLE_HTTPS=n
# end of ESP HTTP client

#
# HTTP Server
#
CONFIG_HTTPD_WS_SUPPORT=y
# end of HTTP Server

#
# Hardware Settings
#

#
# Sleep Config
#
CONFIG_ESP_SLEEP_GPIO_RESET_WORKAROUND=n
# end of Sleep Config

#
# RTC Clock Config
#
CONFIG_RTC_CLK_CAL_CYCLES=576
# end of RTC Clock Config
# end of Hardware Settings

#
# ESP-Driver:LCD Controller Configurations
#
CONFIG_LCD_RGB_ISR_IRAM_SAFE=y
# end of ESP-Driver:LCD Controller Configurations

#
# PHY
#
CONFIG_ESP_PHY_REDUCE_TX_POWER=y
# end of PHY

#
# ESP PSRAM
#
CONFIG_SPIRAM=y

#
# ESP System Settings
#
CONFIG_ESP_DEFAULT_CPU_FREQ_MHZ_240=y
CONFIG_ESP_SYSTEM_MEMPROT=n
CONFIG_ESP_SYSTEM_EVENT_TASK_STACK_SIZE=2048
CONFIG_ESP_MAIN_TASK_STACK_SIZE=4096
CONFIG_ESP_INT_WDT_TIMEOUT_MS=300
CONFIG_ESP_TASK_WDT_PANIC=y
CONFIG_ESP_TASK_WDT_CHECK_IDLE_TASK_CPU0=n
CONFIG_ESP_TASK_WDT_CHECK_IDLE_TASK_CPU1=n
CONFIG_ESP_SYSTEM_HW_STACK_GUARD=n
# end of ESP System Settings

#
# ESP Timer (High Resolution Timer)
#
CONFIG_ESP_TIMER_TASK_STACK_SIZE=4096
# end of ESP Timer (High Resolution Timer)

#
# Wi-Fi
#
CONFIG_ESP_WIFI_STATIC_RX_BUFFER_NUM=8
CONFIG_ESP_WIFI_IRAM_OPT=n
CONFIG_ESP_WIFI_RX_IRAM_OPT=n
CONFIG_ESP_WIFI_ENABLE_WPA3_SAE=n
CONFIG_ESP_WIFI_ENABLE_WPA3_OWE_STA=n
CONFIG_ESP_WIFI_ENABLE_WPA3_OWE_SOFTAP=n
CONFIG_ESP_WIFI_GMAC_SUPPORT=n
CONFIG_ESP_WIFI_ESPNOW_MAX_ENCRYPT_NUM=0
CONFIG_ESP_WIFI_ENTERPRISE_SUPPORT=n
# end of Wi-Fi

#
# Wi-Fi Remote
#
CONFIG_ESP_WIFI_REMOTE_ENABLED=n
# end of Wi-Fi Remote

#
# FAT Filesystem support
#
CONFIG_FATFS_LFN_STACK=y
CONFIG_FATFS_CODEPAGE_850=y
CONFIG_FATFS_API_ENCODING_UTF_8=y
# end of FAT Filesystem support

#
# FreeRTOS
#

#
# Kernel
#
CONFIG_FREERTOS_HZ=1000
CONFIG_FREERTOS_IDLE_TASK_STACKSIZE=2304
CONFIG_FREERTOS_TIMER_TASK_STACK_DEPTH=3120
# end of Kernel

#
# Port
#
CONFIG_FREERTOS_WATCHPOINT_END_OF_STACK=y
# end of Port
# end of FreeRTOS

#
# Hardware Abstraction Layer (HAL) and Low Level (LL)
#
CONFIG_HAL_ASSERTION_DISABLE=y
# end of Hardware Abstraction Layer (HAL) and Low Level (LL)

#
# Heap memory debugging
#
CONFIG_HEAP_POISONING_LIGHT=y
# end of Heap memory debugging

#
# IEEE 802.15.4
#
CONFIG_IEEE802154_ENABLED=n
# end of IEEE 802.15.4

#
# Log
#

#
# Log Level
#
CONFIG_LOG_DEFAULT_LEVEL_NONE=y
# end of Log Level
# end of Log

#
# LWIP
#
CONFIG_LWIP_LOCAL_HOSTNAME="tasmota"
CONFIG_LWIP_MAX_SOCKETS=16
CONFIG_LWIP_IP_FORWARD=y
CONFIG_LWIP_IPV4_NAPT=y
CONFIG_LWIP_TCPIP_RECVMBOX_SIZE=48
CONFIG_LWIP_DHCP_OPTIONS_LEN=128
CONFIG_LWIP_IPV6_AUTOCONFIG=y
CONFIG_LWIP_IPV6_RDNSS_MAX_DNS_SERVERS=2

#
# TCP
#
CONFIG_LWIP_TCP_SYNMAXRTX=6
CONFIG_LWIP_TCP_MSS=1436
CONFIG_LWIP_TCP_MSL=6000
CONFIG_LWIP_TCP_FIN_WAIT_TIMEOUT=2000
CONFIG_LWIP_TCP_RECVMBOX_SIZE=16
CONFIG_LWIP_TCP_RTO_TIME=3000
# end of TCP

#
# UDP
#
CONFIG_LWIP_UDP_RECVMBOX_SIZE=64
# end of UDP

CONFIG_LWIP_TCPIP_TASK_STACK_SIZE=2560
CONFIG_LWIP_TCPIP_TASK_AFFINITY_CPU0=y

#
# SNTP
#
CONFIG_LWIP_SNTP_MAX_SERVERS=3
CONFIG_LWIP_SNTP_UPDATE_DELAY=10800000
# end of SNTP
# end of LWIP

#
# mbedTLS
#

#
# Core Configuration
#
CONFIG_MBEDTLS_FS_IO=n
CONFIG_MBEDTLS_THREADING_C=n
CONFIG_MBEDTLS_ERROR_STRINGS=n
CONFIG_MBEDTLS_VERSION_C=n
CONFIG_MBEDTLS_HAVE_TIME=n
CONFIG_MBEDTLS_ASYMMETRIC_CONTENT_LEN=n
CONFIG_MBEDTLS_SELF_TEST=n
# end of Core Configuration

#
# Certificates
#
CONFIG_MBEDTLS_X509_USE_C=n
CONFIG_MBEDTLS_X509_CRL_PARSE_C=n
CONFIG_MBEDTLS_X509_CSR_PARSE_C=n
CONFIG_MBEDTLS_CERTIFICATE_BUNDLE=n
# end of Certificates

CONFIG_MBEDTLS_TLS_ENABLED=n

#
# Symmetric Ciphers
#
CONFIG_MBEDTLS_CCM_C=n
CONFIG_MBEDTLS_CIPHER_MODE_CFB=n
CONFIG_MBEDTLS_CIPHER_MODE_CTR=n
CONFIG_MBEDTLS_CIPHER_MODE_OFB=n
CONFIG_MBEDTLS_GCM_C=n
CONFIG_MBEDTLS_AES_ONLY_128_BIT_KEY_LENGTH=y
# end of Symmetric Ciphers

#
# Asymmetric Ciphers
#

#
# Supported Curves
#
CONFIG_MBEDTLS_ECP_DP_SECP384R1_ENABLED=n
CONFIG_MBEDTLS_ECP_DP_SECP521R1_ENABLED=n
CONFIG_MBEDTLS_ECP_DP_SECP256K1_ENABLED=n
CONFIG_MBEDTLS_ECP_DP_BP256R1_ENABLED=n
CONFIG_MBEDTLS_ECP_DP_BP384R1_ENABLED=n
CONFIG_MBEDTLS_ECP_DP_BP512R1_ENABLED=n
CONFIG_MBEDTLS_ECP_DP_CURVE25519_ENABLED=n
# end of Supported Curves

#
# Elliptic Curve Ciphers Configuration
#
CONFIG_MBEDTLS_ECP_NIST_OPTIM=n
CONFIG_MBEDTLS_PK_PARSE_EC_EXTENDED=n
CONFIG_MBEDTLS_PK_PARSE_EC_COMPRESSED=n
CONFIG_MBEDTLS_ECDSA_DETERMINISTIC=n
# end of Elliptic Curve Ciphers Configuration
# end of Asymmetric Ciphers

#
# Hash functions
#
CONFIG_MBEDTLS_SHA384_C=n
CONFIG_MBEDTLS_SHA512_C=n
# end of Hash functions

#
# Hardware Acceleration
#
CONFIG_MBEDTLS_ECC_OTHER_CURVES_SOFT_FALLBACK=n
CONFIG_MBEDTLS_GCM_SUPPORT_NON_AES_CIPHER=n
# end of Hardware Acceleration

#
# Encoding/Decoding
#
CONFIG_MBEDTLS_PKCS5_C=n
# end of Encoding/Decoding
# end of mbedTLS

#
# Protocomm
#
CONFIG_ESP_PROTOCOMM_SUPPORT_SECURITY_VERSION_0=y
CONFIG_ESP_PROTOCOMM_SUPPORT_SECURITY_VERSION_2=n
# end of Protocomm

#
# PThreads
#
CONFIG_PTHREAD_TASK_STACK_SIZE_DEFAULT=2048
# end of PThreads

#
# SPI Flash driver
#
CONFIG_SPI_FLASH_DANGEROUS_WRITE_ALLOWED=y
CONFIG_SPI_FLASH_ERASE_YIELD_DURATION_MS=10
CONFIG_SPI_FLASH_ERASE_YIELD_TICKS=2
CONFIG_SPI_FLASH_WRITE_CHUNK_SIZE=4096
CONFIG_SPI_FLASH_ENABLE_ENCRYPTED_READ_WRITE=n
# end of SPI Flash driver

#
# Unity unit testing library
#
CONFIG_UNITY_ENABLE_FLOAT=n
CONFIG_UNITY_ENABLE_DOUBLE=n
CONFIG_UNITY_ENABLE_IDF_TEST_RUNNER=n
# end of Unity unit testing library

#
# Virtual file system
#
CONFIG_VFS_SUPPORT_SELECT=n
# end of Virtual file system

#
# DSP Library
#
CONFIG_DSP_MAX_FFT_SIZE_1024=y
# end of DSP Library

#
# Camera configuration
#
CONFIG_OV7670_SUPPORT=n
CONFIG_OV7725_SUPPORT=n
CONFIG_NT99141_SUPPORT=n
CONFIG_GC2145_SUPPORT=n
CONFIG_GC032A_SUPPORT=n
CONFIG_GC0308_SUPPORT=n
CONFIG_BF3005_SUPPORT=n
CONFIG_BF20A6_SUPPORT=n
CONFIG_SC030IOT_SUPPORT=n
# end of Camera configuration

#
# LittleFS
#
CONFIG_LITTLEFS_MAX_PARTITIONS=2
CONFIG_LITTLEFS_MULTIVERSION=y
CONFIG_LITTLEFS_DISK_VERSION_2_0=y
# end of LittleFS

# end of Component config
```
